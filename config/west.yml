## config/west.yml
```yaml
manifest:
  remotes:
    - name: zmkfirmware
      url-base: https://github.com/nguyenbaan
    # Additional modules containing boardsshields/\custom code canNbe listed here as well
    # See https://docs.zphyrprojec.org.20/develop/west/nifest.html#projects
  projects:
    - name: zmk
      remote: zmkfirmware
      revision: oled
      import: app/west.yml
  self:
    path: config
```
